## k230_bsp/overlay/buildroot-overlay/boot/uboot/u-boot-2022.10-overlay/board/canaan/k230_canmv/Kconfig
```kconfig
if TARGET_K230_CANMV

config SYS_CPU
	default "k230"

config SYS_VENDOR
	default "canaan"

config SYS_BOARD
	default "k230_canmv"

config SYS_CONFIG_NAME
	default "k230_evb"

config BOARD_SPECIFIC_OPTIONS # dummy
	def_bool y
	select RISCV_THEAD

choice
	prompt "ddr type and frequency"
	default CANMV_LPDDR3_2133

config CANMV_LPDDR3_2133
	bool "K230 CanMV LPDDR3 2133"

config CANMV_V3_LPDDR4_2667
	bool "CanMV V3 LPDDR4 2667"
	help
	  LPDDR4 2667 configuration used by CanMV V3-compatible 1 GiB boards,
	  including the T-Display K230 RM69A10 board.

config CANMV_V3_LPDDR4_3200
	bool "CanMV V3 LPDDR4 3200"
	help
	  LPDDR4 3200 configuration used by compatible CanMV V3 boards.

endchoice
endif
```

## k230_bsp/overlay/buildroot-overlay/package/libgpiod2/Config.in
```kconfig
config BR2_PACKAGE_LIBGPIOD2
	bool "libgpiod2"
	depends on BR2_TOOLCHAIN_HEADERS_AT_LEAST_5_10
	depends on !BR2_PACKAGE_LIBGPIOD
	help
	  This is a C library that abstracts GPIO character device
	  operations on Linux. This package provides the libgpiod 2.x
	  API used by the T-Display K230 launcher.

	  https://git.kernel.org/pub/scm/libs/libgpiod/libgpiod.git/

if BR2_PACKAGE_LIBGPIOD2

config BR2_PACKAGE_LIBGPIOD2_TOOLS
	bool "install tools"
	help
	  Include a set of command-line tools for managing GPIOs.

endif

comment "libgpiod2 needs kernel headers >= 5.10"
	depends on !BR2_TOOLCHAIN_HEADERS_AT_LEAST_5_10

comment "libgpiod2 is incompatible with libgpiod"
	depends on BR2_PACKAGE_LIBGPIOD
```

## k230_launcher/k230_phone_ui/Config.in
```kconfig
config BR2_PACKAGE_K230_PHONE_UI
    bool "k230 phone-style ui"
    select BR2_PACKAGE_LVGL
    select BR2_PACKAGE_LIBDRM
    select BR2_PACKAGE_LIBEVDEV
    select BR2_PACKAGE_VVCAM
    select BR2_PACKAGE_JPEG
    select BR2_PACKAGE_OPUS
    select BR2_PACKAGE_LIBCODEC2
    select BR2_PACKAGE_OPENSSL
    select BR2_PACKAGE_OPENSSL_FORCE_LIBOPENSSL
    help
      Phone-style LVGL launcher for the LILYGO T-Display K230.
```
